## firmware/sdkconfig.defaults
```kconfig
CONFIG_BT_ENABLED=y
CONFIG_BT_NIMBLE_ENABLED=y
CONFIG_BT_NIMBLE_NVS_PERSIST=y
CONFIG_BT_NIMBLE_SVC_GAP_DEVICE_NAME="ESP Keyboard"
CONFIG_ESP_CONSOLE_USB_SERIAL_JTAG=y
CONFIG_BT_BLE_42_FEATURES_SUPPORTED=y
CONFIG_EXAMPLE_KBD_ENABLE=y
CONFIG_PARTITION_TABLE_SINGLE_APP_LARGE=y
```
